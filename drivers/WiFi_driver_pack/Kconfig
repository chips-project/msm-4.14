## drivers/WiFi_driver_pack/Kconfig
```kconfig
comment "External WiFi drivers for android by @s133py"

source "drivers/WiFi_driver_pack/rtl8188eus/Kconfig"

source "drivers/WiFi_driver_pack/rtl8188fu/Kconfig"

source "drivers/WiFi_driver_pack/rtl8812au/Kconfig"

source "drivers/WiFi_driver_pack/rtl8192eu/Kconfig"

source "drivers/WiFi_driver_pack/mt7630/Kconfig"
```

## drivers/WiFi_driver_pack/rtl8192eu/Kconfig
```kconfig
config RTL8192EU
	tristate "Realtek 8192E USB WiFi"
	depends on USB
	default m
	---help---
	  Help message of RTL8192EU
```
